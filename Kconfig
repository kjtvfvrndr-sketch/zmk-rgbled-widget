## Kconfig
```kconfig
config RGBLED_WIDGET
    bool "Enable RGB LED widget for showing battery and output status"

if RGBLED_WIDGET

config LED
    default y

config RGBLED_WIDGET_INTERVAL_MS
    int "Minimum wait duration between two blinks in ms"
    default 500

# Marker for other modules: rgbled_widget_blink() is available (widget.h).
config RGBLED_WIDGET_BLINK_API
    def_bool y

# Marker for other modules: rgbled_widget_blink_on_all_halves() is available
# (widget.h) -- a blink shown on every half of a split, for what concerns the
# whole keyboard.
config RGBLED_WIDGET_BLINK_ON_ALL_HALVES_API
    def_bool y

# Battery level settings

choice RGBLED_WIDGET_BATTERY_SHOW
    prompt "Which battery levels to indicate, non-defaults only work for split centrals"

config RGBLED_WIDGET_BATTERY_SHOW_SELF
    bool "Indicate battery level from self only"

config RGBLED_WIDGET_BATTERY_SHOW_PERIPHERALS
    bool "Indicate battery levels from self and peripherals (if split central)"
    depends on (ZMK_SPLIT && ZMK_SPLIT_ROLE_CENTRAL)
    select ZMK_SPLIT_BLE_CENTRAL_BATTERY_LEVEL_FETCHING

config RGBLED_WIDGET_BATTERY_SHOW_ONLY_PERIPHERALS
    bool "Indicate battery levels from peripherals only (if split central)"
    depends on (ZMK_SPLIT && ZMK_SPLIT_ROLE_CENTRAL)
    select ZMK_SPLIT_BLE_CENTRAL_BATTERY_LEVEL_FETCHING

endchoice

config RGBLED_WIDGET_BATTERY_BLINK_MS
    int "Duration of battery level blink in ms"
    default 2000

config RGBLED_WIDGET_BATTERY_LEVEL_HIGH
    int "High battery level percentage"
    range 2 100
    default 80
    help
      At and above this level the battery shows BATTERY_RGB_HIGH. With
      BATTERY_GRADIENT it is where the gradient is fully that colour.

config RGBLED_WIDGET_BATTERY_LEVEL_LOW
    int "Low battery level percentage"
    range 1 99
    default 10
    help
      At and below this level the battery shows BATTERY_RGB_LOW, with and
      without BATTERY_GRADIENT. Must be below BATTERY_LEVEL_HIGH. BATTERY_PULSE starts here too,
      unless BATTERY_PULSE_LEVEL is set.

config RGBLED_WIDGET_BATTERY_LEVEL_CRITICAL
    int "Critical battery level percentage (0 = off)"
    default 0
    help
      One BATTERY_RGB_CRITICAL blink every time ZMK reports a new battery
      level at or below this. Off by default: BATTERY_PULSE warns of a low
      battery at a steady cadence instead.

config RGBLED_WIDGET_BATTERY_RGB_HIGH
    hex "Color for high battery level (LEVEL_HIGH and above) (0xRRGGBB)"
    default 0x00FF00

config RGBLED_WIDGET_BATTERY_RGB_MEDIUM
    hex "Color for medium battery level (between LEVEL_LOW and LEVEL_HIGH; the gradient's midpoint) (0xRRGGBB)"
    default 0xFFFF00

config RGBLED_WIDGET_BATTERY_RGB_LOW
    hex "Color for low battery level (LEVEL_LOW and below) (0xRRGGBB)"
    default 0xFF0000

config RGBLED_WIDGET_BATTERY_RGB_CRITICAL
    hex "Color for critical battery level (below LEVEL_CRITICAL) (0xRRGGBB)"
    default 0xFF0000

config RGBLED_WIDGET_BATTERY_RGB_MISSING
    hex "Color for a battery level not measured yet, or a peripheral's not received (0xRRGGBB)"
    default 0xFF0000
    help
      A level of 0 means nothing measured -- so, for all the keyboard can
      tell, no charge: the low battery colour by default. The log tells it
      from a battery that is really low.

# Connectivity indicator settings
config RGBLED_WIDGET_CONN_BLINK_MS
    int "Duration of a connection status blink in ms"
    default 1000
    help
      The blink on a connection event: connected, lost, a profile switched
      or opened for pairing, and the status at boot. The reminder while the
      link is down has its own, CONN_REMIND_BLINK_MS.

config RGBLED_WIDGET_CONN_SHOW_USB
    bool "Show USB indicator instead of BLE status if it has priority"
    default y
    help
      Blink CONN_RGB_USB when the keys go to USB, and the BLE status when
      they go back: the indicator follows where the keys go, not the
      power. ZMK sends them over USB once a computer has taken the USB
      connection, and over Bluetooth while a connected profile is the
      preferred output (&out). A charger changes nothing, nor does a cable
      while the keys stay on Bluetooth. Off: on USB the connection blinks
      show the BLE profile, and a change of output does not blink.

config RGBLED_WIDGET_CONN_RGB_CONNECTED
    hex "Color for connected BLE connection status (0xRRGGBB)"
    default 0x0000FF

config RGBLED_WIDGET_CONN_RGB_ADVERTISING
    hex "Color for a profile open for pairing (0xRRGGBB)"
    default 0x00FFFF

config RGBLED_WIDGET_CONN_RGB_DISCONNECTED
    hex "Color for a paired profile whose host is not connected, or a peripheral without its central (0xRRGGBB)"
    default 0x00FFFF

config RGBLED_WIDGET_CONN_RGB_USB
    hex "Color for USB endpoint active (0xRRGGBB)"
    default 0xFFFFFF

config RGBLED_WIDGET_CONN_RGB_SPLIT_CONNECTED
    hex "Color for the halves of a split connected to each other (0xRRGGBB)"
    default 0xFF00FF
    help
      A colour of its own, so that blue and cyan always mean the computer.
      Over Bluetooth with LAYER_PUSH the central shows it on itself and on
      the peripheral that came, at the same moment, once that one is ready
      to be synced with (a couple of seconds after the link, for its
      discovery); a peripheral shows none of its own. Without LAYER_PUSH
      the central shows it alone. A peripheral still looking for its
      central keeps CONN_RGB_DISCONNECTED and its reminders.

# Layer indicator settings
config RGBLED_WIDGET_SHOW_LAYER_CHANGE
    bool "Indicate highest active layer on each layer change with a sequence of blinks"

config RGBLED_WIDGET_LAYER_BLINK_MS
    int "Blink and wait duration for layer indicator"
    default 100

config RGBLED_WIDGET_LAYER_RGB
    hex "Color to use for layer indicator (0xRRGGBB)"
    default 0x00FFFF

config RGBLED_WIDGET_LAYER_DEBOUNCE_MS
    int "Wait duration after a layer change before showing the highest active layer"
    default 100

# Constant layer color settings
config RGBLED_WIDGET_SHOW_LAYER_COLORS
    bool "Use custom colors for layers"

config RGBLED_WIDGET_LAYER_0_RGB
    hex "Color to use for the base layer (0xRRGGBB)"
    default 0x000000

config RGBLED_WIDGET_LAYER_1_RGB
    hex "Color to use for layer 1 (0xRRGGBB)"
    default 0x000000

config RGBLED_WIDGET_LAYER_2_RGB
    hex "Color to use for layer 2 (0xRRGGBB)"
    default 0x000000

config RGBLED_WIDGET_LAYER_3_RGB
    hex "Color to use for layer 3 (0xRRGGBB)"
    default 0x000000

config RGBLED_WIDGET_LAYER_4_RGB
    hex "Color to use for layer 4 (0xRRGGBB)"
    default 0x000000

config RGBLED_WIDGET_LAYER_5_RGB
    hex "Color to use for layer 5 (0xRRGGBB)"
    default 0x000000

config RGBLED_WIDGET_LAYER_6_RGB
    hex "Color to use for layer 6 (0xRRGGBB)"
    default 0x000000

config RGBLED_WIDGET_LAYER_7_RGB
    hex "Color to use for layer 7 (0xRRGGBB)"
    default 0x000000

config RGBLED_WIDGET_LAYER_8_RGB
    hex "Color to use for layer 8 (0xRRGGBB)"
    default 0x000000

config RGBLED_WIDGET_LAYER_9_RGB
    hex "Color to use for layer 9 (0xRRGGBB)"
    default 0x000000

config RGBLED_WIDGET_LAYER_10_RGB
    hex "Color to use for layer 10 (0xRRGGBB)"
    default 0x000000

config RGBLED_WIDGET_LAYER_11_RGB
    hex "Color to use for layer 11 (0xRRGGBB)"
    default 0x000000

config RGBLED_WIDGET_LAYER_12_RGB
    hex "Color to use for layer 12 (0xRRGGBB)"
    default 0x000000

config RGBLED_WIDGET_LAYER_13_RGB
    hex "Color to use for layer 13 (0xRRGGBB)"
    default 0x000000

config RGBLED_WIDGET_LAYER_14_RGB
    hex "Color to use for layer 14 (0xRRGGBB)"
    default 0x000000

config RGBLED_WIDGET_LAYER_15_RGB
    hex "Color to use for layer 15 (0xRRGGBB)"
    default 0x000000

config RGBLED_WIDGET_LAYER_16_RGB
    hex "Color to use for layer 16 (0xRRGGBB)"
    default 0x000000

config RGBLED_WIDGET_LAYER_17_RGB
    hex "Color to use for layer 17 (0xRRGGBB)"
    default 0x000000

config RGBLED_WIDGET_LAYER_18_RGB
    hex "Color to use for layer 18 (0xRRGGBB)"
    default 0x000000

config RGBLED_WIDGET_LAYER_19_RGB
    hex "Color to use for layer 19 (0xRRGGBB)"
    default 0x000000

config RGBLED_WIDGET_LAYER_20_RGB
    hex "Color to use for layer 20 (0xRRGGBB)"
    default 0x000000

config RGBLED_WIDGET_LAYER_21_RGB
    hex "Color to use for layer 21 (0xRRGGBB)"
    default 0x000000

config RGBLED_WIDGET_LAYER_22_RGB
    hex "Color to use for layer 22 (0xRRGGBB)"
    default 0x000000

config RGBLED_WIDGET_LAYER_23_RGB
    hex "Color to use for layer 23 (0xRRGGBB)"
    default 0x000000

config RGBLED_WIDGET_LAYER_24_RGB
    hex "Color to use for layer 24 (0xRRGGBB)"
    default 0x000000

config RGBLED_WIDGET_LAYER_25_RGB
    hex "Color to use for layer 25 (0xRRGGBB)"
    default 0x000000

config RGBLED_WIDGET_LAYER_26_RGB
    hex "Color to use for layer 26 (0xRRGGBB)"
    default 0x000000

config RGBLED_WIDGET_LAYER_27_RGB
    hex "Color to use for layer 27 (0xRRGGBB)"
    default 0x000000

config RGBLED_WIDGET_LAYER_28_RGB
    hex "Color to use for layer 28 (0xRRGGBB)"
    default 0x000000

config RGBLED_WIDGET_LAYER_29_RGB
    hex "Color to use for layer 29 (0xRRGGBB)"
    default 0x000000

config RGBLED_WIDGET_LAYER_30_RGB
    hex "Color to use for layer 30 (0xRRGGBB)"
    default 0x000000

config RGBLED_WIDGET_LAYER_31_RGB
    hex "Color to use for layer 31 (0xRRGGBB)"
    default 0x000000

# ---------------------------------------------------------------------------
# K:04 fork additions
# ---------------------------------------------------------------------------

config RGBLED_WIDGET_BRIGHTNESS
    int "Global brightness scale, percent"
    range 1 100
    default 30
    help
      Every colour is scaled by this before being written to the strip.
      A bare WS2812 sitting under your palm at full duty is painfully
      bright; start low and raise it if you cannot see the indicator.

config RGBLED_WIDGET_GAIN_R
    int "Red channel gain, percent of the value written in the colour"
    range 0 100
    default 100
    help
      100 leaves the channel exactly as the hex colour says, so 0xFFFFFF is
      white and 0x808080 is grey. Lower it only to correct a die that reads too
      bright on your particular LED -- any value below 100 means hex codes no
      longer render literally, so prefer adjusting the colours themselves.

config RGBLED_WIDGET_GAIN_G
    int "Green channel gain, percent of the value written in the colour"
    range 0 100
    default 100
    help
      100 leaves the channel exactly as the hex colour says, so 0xFFFFFF is
      white and 0x808080 is grey. Lower it only to correct a die that reads too
      bright on your particular LED -- any value below 100 means hex codes no
      longer render literally, so prefer adjusting the colours themselves.

config RGBLED_WIDGET_GAIN_B
    int "Blue channel gain, percent of the value written in the colour"
    range 0 100
    default 100
    help
      100 leaves the channel exactly as the hex colour says, so 0xFFFFFF is
      white and 0x808080 is grey. Lower it only to correct a die that reads too
      bright on your particular LED -- any value below 100 means hex codes no
      longer render literally, so prefer adjusting the colours themselves.


config RGBLED_WIDGET_BATTERY_GRADIENT
    bool "Show battery level as a gradient between the HIGH, MEDIUM and LOW colours"
    default y
    help
      Blends the threshold colours instead of jumping between them:
      BATTERY_RGB_HIGH at BATTERY_LEVEL_HIGH and above, BATTERY_RGB_LOW at
      BATTERY_LEVEL_LOW and below, BATTERY_RGB_MEDIUM halfway between the
      two levels, and a smooth blend in between. The blend keeps the
      brightness of its two ends, so it does not dim halfway between two
      colours that sit far apart. With the defaults: green from 80%,
      yellow at 45%, red at 10%. When disabled, the three colours switch
      at the two levels.

config RGBLED_WIDGET_BATTERY_PULSE
    bool "Periodically breathe a warning while the battery is low"
    depends on ZMK_BATTERY_REPORTING
    default y
    help
      zmk_battery_state_changed only fires when the reported percentage
      actually changes, which near the bottom of the range can be an hour
      apart. This polls the cached level on a timer instead, so the warning
      appears at a predictable cadence.

if RGBLED_WIDGET_BATTERY_PULSE

config RGBLED_WIDGET_BATTERY_PULSE_LEVEL
    int "Pulse at and below this battery percentage"
    range 1 100
    default RGBLED_WIDGET_BATTERY_LEVEL_LOW
    help
      BATTERY_LEVEL_LOW by default: the pulse starts where the battery
      colour has become BATTERY_RGB_LOW.

config RGBLED_WIDGET_BATTERY_PULSE_PERIOD_S
    int "Seconds between pulse groups"
    default 60

config RGBLED_WIDGET_BATTERY_PULSE_COUNT
    int "Breaths per warning"
    range 1 8
    default 2

config RGBLED_WIDGET_BATTERY_PULSE_BREATHE_CYCLE_MS
    int "Duration of one warning breath, dark to full and back, in ms"
    range 200 10000
    default 1000
    help
      A breath, like the one when USB power arrives -- red for want of
      power, green for power there -- so it is not taken for the three
      short red blinks of a refusal (zmk-ble-host-link).

config RGBLED_WIDGET_BATTERY_PULSE_RGB
    hex "Colour of the low battery pulse (0xRRGGBB)"
    default 0xFF0000

endif # RGBLED_WIDGET_BATTERY_PULSE

config RGBLED_WIDGET_POWER_CONNECTED_BREATHE
    bool "Breathe in the full battery colour when USB power arrives"
    # The nRF52 VBUS detector sits in POWER wherever there is USBD.
    depends on (SOC_SERIES_NRF52X && HAS_HW_NRF_USBD) || USB_DEVICE_STACK
    default y
    help
      When USB power arrives, the LED breathes in BATTERY_RGB_HIGH: from
      dark up to the colour as it normally shows (at BRIGHTNESS) and back,
      POWER_CONNECTED_BREATHE_COUNT times. At boot and on waking from deep
      sleep with USB power it takes the place of the battery colour, which
      says nothing on a cable. It tells of the power, not of charging: a
      full battery breathes too.

      On a running half it starts at once: if a computer then takes the
      connection, that connection blink waits for the breathe to end -- on
      a central it then shows on every half at once. It stops when the
      power goes, and a new layer colour ends it as it ends every
      indication.

config RGBLED_WIDGET_POWER_CONNECTED_BREATHE_COUNT
    int "Breaths when USB power arrives"
    depends on RGBLED_WIDGET_POWER_CONNECTED_BREATHE
    range 1 10
    default 2

config RGBLED_WIDGET_POWER_CONNECTED_BREATHE_CYCLE_MS
    int "Duration of one breath, dark to full and back, in ms"
    depends on RGBLED_WIDGET_POWER_CONNECTED_BREATHE
    range 200 10000
    default 1000
    help
      Two breaths of 1 s take as long as the battery colour on battery
      (BATTERY_BLINK_MS), so at boot both halves get to the connection
      blinks together.

config RGBLED_WIDGET_BLANK_TIMEOUT_MS
    int "Default blanking time in ms, used by any layer that does not set its own (0 = never)"
    default 1000
    help
      Independent of ZMK's activity state. This matters on a split peripheral:
      ZMK raises ZMK_ACTIVITY_IDLE only on the ACTIVE -> IDLE transition, so a
      peripheral you never touch goes idle exactly once. Every layer colour the
      central pushes after that lights the LED again with no further idle event
      to turn it back off, leaving it lit for hours. This timer covers that.

      Sub-second values turn the indicator into a flash on change rather than
      a steady light, which matters a lot for battery: an auto-activated mouse
      layer toggles constantly during trackball use, so a steady colour there
      means the LED is lit essentially all the time. 800 ms is still easy to
      catch out of the corner of your eye. Set 0 to keep the colour until the
      next change.

config RGBLED_WIDGET_LAYER_COLOUR_SHOWN_AT_LEAST_MS
    int "A layer colour shows at least this long before the next one (ms, 0: off)"
    range 0 1000
    default 100
    help
      A new layer colour waits until the one before it has shown this long
      -- or until that one blanked, if sooner; a colour that lights nothing
      (0x000000) holds nothing back. So a quick tap of a layer key still
      flashes in full: on a split over Bluetooth the press and the release
      can reach the other half in the same connection event, and both
      halves would otherwise change twice within milliseconds. Each half
      times it from the moments both agreed on, so they stay together --
      set it alike on both; after a sleep, or a colour one half shows alone
      (the other not ready, or left out), they may differ once by up to
      this much. The cost: a change that follows within this time comes up
      to this much later -- never more, however many follow, so a burst
      does not pile up. 0 shows every colour at once.

config RGBLED_WIDGET_OFF_ON_IDLE
    bool "Turn the LED off when the keyboard goes idle"
    default y
    help
      A lit WS2812 draws milliamps continuously -- far more than anything else
      on an idle keyboard. Deep sleep already blanks it, but ZMK_IDLE_TIMEOUT
      fires much sooner than ZMK_IDLE_SLEEP_TIMEOUT, so blanking on idle as
      well cuts LED-on time dramatically while keeping the indicator visible
      whenever you are actually typing. The colour is restored on the next
      keypress.

config RGBLED_WIDGET_CONN_REMIND
    bool "Periodically re-blink while the link is down"
    default y
    help
      Connection status is otherwise shown only on a change and once at
      boot, so a keyboard whose link is down shows nothing after that one
      blink. This repeats a short blink in the status colour until the
      link comes up: CONN_RGB_DISCONNECTED, or CONN_RGB_ADVERTISING while
      the profile is open for pairing. On a central that means the active
      BLE profile (nothing while the output is USB); on a peripheral, the
      link to the central. The first reminder comes CONN_REMIND_PERIOD_S
      after the last connection blink, then one every period, idle or not,
      until the link is up or the keyboard sleeps.

config RGBLED_WIDGET_CONN_REMIND_PERIOD_S
    int "Seconds between reminder blinks"
    depends on RGBLED_WIDGET_CONN_REMIND
    default 5

config RGBLED_WIDGET_CONN_REMIND_BLINK_MS
    int "Duration of a reminder blink in ms"
    depends on RGBLED_WIDGET_CONN_REMIND
    default 300

config RGBLED_WIDGET_LAYER_PUSH
    bool "Mirror the layer colour onto split peripherals"
    depends on RGBLED_WIDGET_SHOW_LAYER_COLORS && ZMK_SPLIT && ZMK_SPLIT_ROLE_CENTRAL
    default y
    help
      On by default wherever layer colours are shown on a split central;
      =n turns it off. ZMK has no split message for layer state, so the
      central sends the resolved colour and its blanking time to each
      peripheral as the lyr_sync behavior, which this module declares; the
      peripheral needs no copy of the layer table, but does need this
      module. The latest colour always wins.

      Over Bluetooth a layer change shows on every half at the same moment.
      The central sends it to each peripheral that is ready; the peripheral
      answers, over a characteristic of its own, when it will show it --
      timed from the connection event that brought the write -- and the
      central shows it then too. So this half shows its own change as late
      as the other half hears of it: up to one attendance of the other half
      (interval * (latency + 1) of the split link) and one connection
      interval more. A colour not sent yet is replaced by the next. A
      peripheral that does not answer within a second is left out, and one
      just connected is sent the current colour on its own once it is
      ready. Both halves need this firmware; a peripheral without the
      answers shows what it is sent on arrival.

      Writes to the split link hold Bluetooth buffers the central shares
      with its reports to the computer until they are acknowledged, and a
      peripheral that has gone away but is not yet declared lost
      acknowledges nothing -- so at most four wait per peripheral, and a
      trackball on the central is not starved. Writes that stay
      unacknowledged past the supervision timeout on a link that is up are
      stuck in the host's queue: they are written off and the colour is
      sent again.

      On a central with a pointing device, CONFIG_BT_L2CAP_TX_BUF_COUNT=10
      (with CONFIG_BT_BUF_ACL_TX_COUNT=10) gives the reports to the
      computer twice the default room. It also makes much rarer a Zephyr
      3.5 fault that loses a buffer for good when the split link drops
      while a write waits for one.

      Over a wired split the colour goes through ZMK's own split command,
      from the system work queue as ZMK sends its own, and shows on arrival.
      ZMK does not report a wired peripheral coming back, so one that was
      unplugged or restarted shows the colour from the next layer change
      on. A build with both transports sends over Bluetooth only.

config RGBLED_WIDGET_PUSH_INDICATIONS_TO_PERIPHERALS
    bool "Show what concerns the whole keyboard on split peripherals too"
    depends on RGBLED_WIDGET_LAYER_PUSH
    default y
    help
      The state of the computer's link -- blue connected, cyan open or not
      connected (and its reminders), white the keys on USB -- the battery
      key (each half its own colour) and the blinks other modules send with
      rgbled_widget_blink_on_all_halves(), such as zmk-ble-host-link's
      answers, show on every peripheral too. Over Bluetooth they show on
      every half at the same moment, as the layer colour does: each goes
      out when its turn comes on the central's LED, and the central holds
      it until the peripherals have answered when they can show it -- after
      what a peripheral shows at that moment, ahead of what of its own
      waits. A peripheral that is not ready when an indication's turn
      comes is not sent it: one connecting later starts with the
      split-connected blink. What is the half's own -- its battery at boot and when
      low, its USB power, its link to the central when that is down --
      stays on that half.

config RGBLED_WIDGET_LAYER_PUSH_STACK_SIZE
    int "Stack of the thread that sends the layer colour"
    depends on RGBLED_WIDGET_LAYER_PUSH && ZMK_SPLIT_BLE
    default 1792 if LOG
    default 1280
    help
      Over Bluetooth the colour is sent from a work queue of its own, where
      waiting for a Bluetooth buffer holds up nothing outside it. Its deepest
      path measures about 1.2 KB with logging and 0.5 KB without, plus
      about 0.2 KB for the queue and an interrupt; the build stops below
      1536 and 1024. A wired split sends from the system work queue.

config RGBLED_WIDGET_LAYER_PUSH_THREAD_PRIORITY
    int "Priority of the thread that sends the layer colour"
    depends on RGBLED_WIDGET_LAYER_PUSH && ZMK_SPLIT_BLE
    range 0 14
    default 10
    help
      Preemptible, as ZMK's own low-priority work queue.

config RGBLED_WIDGET_LAYER_0_MS
    int "Blank the LED this many ms after layer 0 lights it (0 = never)"
    default RGBLED_WIDGET_BLANK_TIMEOUT_MS

config RGBLED_WIDGET_LAYER_1_MS
    int "Blank the LED this many ms after layer 1 lights it (0 = never)"
    default RGBLED_WIDGET_BLANK_TIMEOUT_MS

config RGBLED_WIDGET_LAYER_2_MS
    int "Blank the LED this many ms after layer 2 lights it (0 = never)"
    default RGBLED_WIDGET_BLANK_TIMEOUT_MS

config RGBLED_WIDGET_LAYER_3_MS
    int "Blank the LED this many ms after layer 3 lights it (0 = never)"
    default RGBLED_WIDGET_BLANK_TIMEOUT_MS

config RGBLED_WIDGET_LAYER_4_MS
    int "Blank the LED this many ms after layer 4 lights it (0 = never)"
    default RGBLED_WIDGET_BLANK_TIMEOUT_MS

config RGBLED_WIDGET_LAYER_5_MS
    int "Blank the LED this many ms after layer 5 lights it (0 = never)"
    default RGBLED_WIDGET_BLANK_TIMEOUT_MS

config RGBLED_WIDGET_LAYER_6_MS
    int "Blank the LED this many ms after layer 6 lights it (0 = never)"
    default RGBLED_WIDGET_BLANK_TIMEOUT_MS

config RGBLED_WIDGET_LAYER_7_MS
    int "Blank the LED this many ms after layer 7 lights it (0 = never)"
    default RGBLED_WIDGET_BLANK_TIMEOUT_MS

config RGBLED_WIDGET_LAYER_8_MS
    int "Blank the LED this many ms after layer 8 lights it (0 = never)"
    default RGBLED_WIDGET_BLANK_TIMEOUT_MS

config RGBLED_WIDGET_LAYER_9_MS
    int "Blank the LED this many ms after layer 9 lights it (0 = never)"
    default RGBLED_WIDGET_BLANK_TIMEOUT_MS

config RGBLED_WIDGET_LAYER_10_MS
    int "Blank the LED this many ms after layer 10 lights it (0 = never)"
    default RGBLED_WIDGET_BLANK_TIMEOUT_MS

config RGBLED_WIDGET_LAYER_11_MS
    int "Blank the LED this many ms after layer 11 lights it (0 = never)"
    default RGBLED_WIDGET_BLANK_TIMEOUT_MS

config RGBLED_WIDGET_LAYER_12_MS
    int "Blank the LED this many ms after layer 12 lights it (0 = never)"
    default RGBLED_WIDGET_BLANK_TIMEOUT_MS

config RGBLED_WIDGET_LAYER_13_MS
    int "Blank the LED this many ms after layer 13 lights it (0 = never)"
    default RGBLED_WIDGET_BLANK_TIMEOUT_MS

config RGBLED_WIDGET_LAYER_14_MS
    int "Blank the LED this many ms after layer 14 lights it (0 = never)"
    default RGBLED_WIDGET_BLANK_TIMEOUT_MS

config RGBLED_WIDGET_LAYER_15_MS
    int "Blank the LED this many ms after layer 15 lights it (0 = never)"
    default RGBLED_WIDGET_BLANK_TIMEOUT_MS

config RGBLED_WIDGET_LAYER_16_MS
    int "Blank the LED this many ms after layer 16 lights it (0 = never)"
    default RGBLED_WIDGET_BLANK_TIMEOUT_MS

config RGBLED_WIDGET_LAYER_17_MS
    int "Blank the LED this many ms after layer 17 lights it (0 = never)"
    default RGBLED_WIDGET_BLANK_TIMEOUT_MS

config RGBLED_WIDGET_LAYER_18_MS
    int "Blank the LED this many ms after layer 18 lights it (0 = never)"
    default RGBLED_WIDGET_BLANK_TIMEOUT_MS

config RGBLED_WIDGET_LAYER_19_MS
    int "Blank the LED this many ms after layer 19 lights it (0 = never)"
    default RGBLED_WIDGET_BLANK_TIMEOUT_MS

config RGBLED_WIDGET_LAYER_20_MS
    int "Blank the LED this many ms after layer 20 lights it (0 = never)"
    default RGBLED_WIDGET_BLANK_TIMEOUT_MS

config RGBLED_WIDGET_LAYER_21_MS
    int "Blank the LED this many ms after layer 21 lights it (0 = never)"
    default RGBLED_WIDGET_BLANK_TIMEOUT_MS

config RGBLED_WIDGET_LAYER_22_MS
    int "Blank the LED this many ms after layer 22 lights it (0 = never)"
    default RGBLED_WIDGET_BLANK_TIMEOUT_MS

config RGBLED_WIDGET_LAYER_23_MS
    int "Blank the LED this many ms after layer 23 lights it (0 = never)"
    default RGBLED_WIDGET_BLANK_TIMEOUT_MS

config RGBLED_WIDGET_LAYER_24_MS
    int "Blank the LED this many ms after layer 24 lights it (0 = never)"
    default RGBLED_WIDGET_BLANK_TIMEOUT_MS

config RGBLED_WIDGET_LAYER_25_MS
    int "Blank the LED this many ms after layer 25 lights it (0 = never)"
    default RGBLED_WIDGET_BLANK_TIMEOUT_MS

config RGBLED_WIDGET_LAYER_26_MS
    int "Blank the LED this many ms after layer 26 lights it (0 = never)"
    default RGBLED_WIDGET_BLANK_TIMEOUT_MS

config RGBLED_WIDGET_LAYER_27_MS
    int "Blank the LED this many ms after layer 27 lights it (0 = never)"
    default RGBLED_WIDGET_BLANK_TIMEOUT_MS

config RGBLED_WIDGET_LAYER_28_MS
    int "Blank the LED this many ms after layer 28 lights it (0 = never)"
    default RGBLED_WIDGET_BLANK_TIMEOUT_MS

config RGBLED_WIDGET_LAYER_29_MS
    int "Blank the LED this many ms after layer 29 lights it (0 = never)"
    default RGBLED_WIDGET_BLANK_TIMEOUT_MS

config RGBLED_WIDGET_LAYER_30_MS
    int "Blank the LED this many ms after layer 30 lights it (0 = never)"
    default RGBLED_WIDGET_BLANK_TIMEOUT_MS

config RGBLED_WIDGET_LAYER_31_MS
    int "Blank the LED this many ms after layer 31 lights it (0 = never)"
    default RGBLED_WIDGET_BLANK_TIMEOUT_MS

config RGBLED_WIDGET_LOG_LED_THREAD_STALLS
    bool "Log when the LED thread stops taking its commands"
    default y if RGBLED_WIDGET_LOG_LEVEL_DBG
    help
      Once a second, from the system work queue, whether the LED thread
      still goes round its loop when it should: with commands waiting for
      it, or past the time it meant to. A WRN once it has not for 3 s --
      with the thread's state (pending, and on what: the strip lock, or an
      object's address for zephyr.map; or just not getting the CPU), the
      commands waiting and whether the first indication holds for a synced
      start -- and an INF when it moves again. For an LED that
      stops showing anything while the rest of the keyboard works. On with
      the widget's DBG logs; it wakes the CPU once a second.

# The widget logs under its own module rather than ZMK's, so its output can
# be turned down without touching anything else. Default is INF: start-up,
# connection, battery and idle events. _WRN keeps only errors; _DBG adds the
# per-layer-change lines, which arrive every time the auto-mouse layer
# toggles.
module = RGBLED_WIDGET
module-str = rgbled_widget
source "${ZEPHYR_BASE}/subsys/logging/Kconfig.template.log_config"

endif # RGBLED_WIDGET

DT_COMPAT_ZMK_BEHAVIOR_RGBLED_WIDGET := zmk,behavior-rgbled-widget
DT_COMPAT_ZMK_BEHAVIOR_RGBLED_SYNC := zmk,behavior-rgbled-sync

config ZMK_BEHAVIOR_RGBLED_WIDGET
    bool
    default $(dt_compat_enabled,$(DT_COMPAT_ZMK_BEHAVIOR_RGBLED_WIDGET))

# Driven by its own compatible, not by the widget behavior's. The lyr_sync node
# is declared without /omit-if-no-ref/ (the central finds it by name over the
# split link, so nothing in a keymap references it), which means this compatible
# is enabled whenever the module is present.
config ZMK_BEHAVIOR_RGBLED_SYNC
    bool
    depends on RGBLED_WIDGET
    default $(dt_compat_enabled,$(DT_COMPAT_ZMK_BEHAVIOR_RGBLED_SYNC))
```
